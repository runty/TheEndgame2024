## 003 FIRMWARE/zmk-endgame-nice-nano-cirque/status-pulse/dts/bindings/behaviors/zmk,behavior-endgame-status-pulse.yaml
```yaml
description: Explicit single status LED test pulse
compatible: "zmk,behavior-endgame-status-pulse"
include: zero_param.yaml
```

## 003 FIRMWARE/zmk-endgame-nice-nano/status-pulse/dts/bindings/led_strip/endgame,ws2812-v6-spi.yaml
```yaml
description: Single WS2812B-V6 pixel with 20-bit symbols at 16 MHz
compatible: "endgame,ws2812-v6-spi"
include: spi-device.yaml
```

## 003 FIRMWARE/zmk-endgame-rp2040-zero/config/boards/waveshare/rp2040_zero/Kconfig.rp2040_zero
```kconfig
config BOARD_RP2040_ZERO
    select ZMK_BOARD_COMPAT if BOARD_RP2040_ZERO_RP2040_ZMK
    imply RETAINED_MEM if BOARD_RP2040_ZERO_RP2040_ZMK
    imply RETENTION if BOARD_RP2040_ZERO_RP2040_ZMK
    imply RETENTION_BOOT_MODE if BOARD_RP2040_ZERO_RP2040_ZMK
```

## 003 FIRMWARE/zmk-endgame-rp2040-zero/config/boards/waveshare/rp2040_zero/rp2040_zero_rp2040_zmk_defconfig
```kconfig
CONFIG_SYS_CLOCK_HW_CYCLES_PER_SEC=125000000

CONFIG_RESET=y
CONFIG_CLOCK_CONTROL=y
CONFIG_GPIO=y

CONFIG_USE_DT_CODE_PARTITION=y
CONFIG_BUILD_OUTPUT_UF2=y
CONFIG_BUILD_OUTPUT_HEX=y

CONFIG_ZMK_USB=y

CONFIG_MPU_ALLOW_FLASH_WRITE=y
CONFIG_NVS=y
CONFIG_SETTINGS_NVS=y
CONFIG_FLASH=y
CONFIG_FLASH_PAGE_LAYOUT=y
CONFIG_FLASH_MAP=y

CONFIG_RETAINED_MEM=y
CONFIG_RETENTION=y
CONFIG_RETENTION_BOOT_MODE=y
```

## 003 FIRMWARE/zmk-endgame/config/boards/shields/endgame/Kconfig.defconfig
```kconfig
if SHIELD_ENDGAME

config ZMK_KEYBOARD_NAME
    default "The Endgame"

config SPI
    default y

endif
```
